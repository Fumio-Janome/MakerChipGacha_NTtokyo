## sdkconfig.defaults
```kconfig
# ESP32-C3 Configuration

# Target Configuration
CONFIG_IDF_TARGET="esp32c3"
CONFIG_IDF_TARGET_ESP32C3=y

# Serial flasher config
CONFIG_ESPTOOLPY_FLASHMODE_DIO=y
CONFIG_ESPTOOLPY_FLASHSIZE_4MB=y
CONFIG_ESPTOOLPY_FLASHFREQ_40M=y

# ESP32-C3 specific config
CONFIG_ESP32C3_REV_MIN_3=y

# Bootloader config
CONFIG_BOOTLOADER_LOG_LEVEL_INFO=y

# Compiler options
CONFIG_COMPILER_OPTIMIZATION_SIZE=y

# Log output
CONFIG_LOG_DEFAULT_LEVEL_INFO=y
CONFIG_LOG_COLORS=y

# FreeRTOS
CONFIG_FREERTOS_HZ=1000

# Driver configuration
CONFIG_ESP_CONSOLE_UART_DEFAULT=y

# NVS configuration
CONFIG_NVS_ENCRYPTION=n

# Component config end
```
